## config/west.yml
```yaml
manifest:
  remotes:
    - name: zmkfirmware
      url-base: https://github.com/zmkfirmware
    - name: urob
      url-base: https://github.com/urob
    - name: mctechnology17
      url-base: https://github.com/tweaknmod
  projects:
    - name: zmk
      remote: zmkfirmware
      revision: v0.3
      import: app/west.yml
    - name: zmk-helpers
      remote: urob
      revision: v0.2
      path: modules/zmk/helpers
    - name: zmk-nice-oled
      remote: mctechnology17
      revision: main
      path: modules/zmk-nice-oled
  self:
    path: config
```
